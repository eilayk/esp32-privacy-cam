## sdkconfig.defaults
```kconfig
# Rust often needs a bit of an extra main task stack size compared to C (the default is 3K)
CONFIG_ESP_MAIN_TASK_STACK_SIZE=8000

# Use this to set FreeRTOS kernel tick frequency to 1000 Hz (100 Hz by default).
# This allows to use 1 ms granularity for thread sleeps (1ms yield).
CONFIG_FREERTOS_HZ=1000

# Optimization settings
CONFIG_COMPILER_OPTIMIZATION_PERF=y
CONFIG_ESP32S3_DEFAULT_CPU_FREQ_240=y
CONFIG_ESP32S3_INSTRUCTION_CACHE_64KB=y
CONFIG_ESP32S3_INSTRUCTION_CACHE_LINE_64B=y
CONFIG_ESP32S3_DATA_CACHE_64KB=y
CONFIG_ESP32S3_DATA_CACHE_LINE_64B=y

# Enable AI instructions for esp-dl
CONFIG_ESP_DL_USE_AI_INSTRUCTIONS=y

# Task Watchdog Timer
CONFIG_ESP_TASK_WDT_TIMEOUT_S=10

# Enable PSRAM for camera frame buffer allocation
CONFIG_SPIRAM=y
CONFIG_SPIRAM_TYPE_AUTO=y
CONFIG_SPIRAM_MODE_OCT=y
CONFIG_SPIRAM_SPEED_80M=y
CONFIG_SPIRAM_BOOT_INIT=y
CONFIG_SPIRAM_USE_MALLOC=y
CONFIG_SPIRAM_MALLOC_ALWAYSINTERNAL=4096
CONFIG_SPIRAM_MALLOC_RESERVE_INTERNAL=32768

# Enable WebSocket support for HTTP server
CONFIG_HTTPD_WS_SUPPORT=y
```
